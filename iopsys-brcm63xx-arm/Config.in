## iopsys-brcm63xx-arm/Config.in
```kconfig
comment "Target options"

# target config
config 	KERNEL_GIT_CLONE_URI
	string
	default "http://public.inteno.se/bcmlinux.git" if TARGET_iopsys_brcm63xx_arm

config 	KERNEL_GIT_BRANCH
	string
	default "bcm_4.16L.04" if TARGET_iopsys_brcm63xx_arm

# brcm has it's own brctl
config 	BUSYBOX_DEFAULT_BRCTL
	bool
	default n if TARGET_iopsys_brcm63xx_arm

# brcm has it's own ifconfig
config 	BUSYBOX_DEFAULT_IFCONFIG
	bool
	default n if TARGET_iopsys_brcm63xx_arm


	


config BCM_KERNEL_PROFILE
       string

       default "963138BGWV" if TARGET_iopsys_brcm63xx_arm_dg400

config BCM_CHIP_ID
       string

       default "63138" if TARGET_iopsys_brcm63xx_arm_dg400


config TARGET_MODEL_NAME
	string

	default "DG400-WU7U" if TARGET_iopsys_brcm63xx_arm_dg400

config TARGET_IBOARDID
	string

	default "DG400" if TARGET_iopsys_brcm63xx_arm_dg400
```

## iopsys-brcm63xx-mips/Config.in
```kconfig
# target config
config 	KERNEL_GIT_CLONE_URI
	string
	default "git@public.inteno.se:bcmlinux.git" if TARGET_iopsys_brcm63xx_mips

config 	KERNEL_GIT_BRANCH
	string
	default "bcm_4.16L.04" if TARGET_iopsys_brcm63xx_mips

# brcm has it's own brctl
config 	BUSYBOX_DEFAULT_BRCTL
	bool
	default n if TARGET_iopsys_brcm63xx_mips

# brcm has it's own ifconfig
config 	BUSYBOX_DEFAULT_IFCONFIG
	bool
	default n if TARGET_iopsys_brcm63xx_mips

config BCM_KERNEL_PROFILE
       string
       default "963268GWV" if TARGET_iopsys_brcm63xx_mips_dg301
       default "963268GWV" if TARGET_iopsys_brcm63xx_mips_cg300
       default "963268GWV" if TARGET_iopsys_brcm63xx_mips_cg301
       default "963268GWV" if TARGET_iopsys_brcm63xx_mips_dg200
       default "963268GWV" if TARGET_iopsys_brcm63xx_mips_dg200al
       default "963268GWV" if TARGET_iopsys_brcm63xx_mips_dg301al
       default "963268GWV" if TARGET_iopsys_brcm63xx_mips_eg200
       default "963268GWV" if TARGET_iopsys_brcm63xx_mips_eg300
       default "963268GWV" if TARGET_iopsys_brcm63xx_mips_vg50
       default "963268GWV" if TARGET_iopsys_brcm63xx_mips_vox25

       default "96362GWV" if TARGET_iopsys_brcm63xx_mips_dg150
       default "963381GWV" if TARGET_iopsys_brcm63xx_mips_dg150v2


config BCM_CHIP_ID
       string
       default "63268" if TARGET_iopsys_brcm63xx_mips_dg301
       default "63268" if TARGET_iopsys_brcm63xx_mips_cg300
       default "63268" if TARGET_iopsys_brcm63xx_mips_cg301
       default "63268" if TARGET_iopsys_brcm63xx_mips_dg200
       default "63268" if TARGET_iopsys_brcm63xx_mips_dg200al
       default "63268" if TARGET_iopsys_brcm63xx_mips_dg301al
       default "63268" if TARGET_iopsys_brcm63xx_mips_eg200
       default "63268" if TARGET_iopsys_brcm63xx_mips_eg300
       default "63268" if TARGET_iopsys_brcm63xx_mips_vg50
       default "63268" if TARGET_iopsys_brcm63xx_mips_vox25

       default "6362" if TARGET_iopsys_brcm63xx_mips_dg150
       default "63381" if TARGET_iopsys_brcm63xx_mips_dg150v2


config TARGET_MODEL_NAME
	string
	prompt "Model name + configuration" if TARGET_iopsys_brcm63xx_mips_Default

	default "CG300-WU21U" if TARGET_iopsys_brcm63xx_mips_cg300
	default "CG301-WU21U" if TARGET_iopsys_brcm63xx_mips_cg301
	default "DG200-WU7P2U" if TARGET_iopsys_brcm63xx_mips_dg200
	default "DG200AL-WU7U" if TARGET_iopsys_brcm63xx_mips_dg200al
	default "DG301AL-WU7U" if TARGET_iopsys_brcm63xx_mips_dg301al
	default "EG200-WU7P1U" if TARGET_iopsys_brcm63xx_mips_eg200
	default "EG300-WU21U" if TARGET_iopsys_brcm63xx_mips_eg300
	default "DG301-W7P2U" if TARGET_iopsys_brcm63xx_mips_dg301
	default "VG50-WU7U" if TARGET_iopsys_brcm63xx_mips_vg50
	default "VOX25-WU7P2U" if TARGET_iopsys_brcm63xx_mips_vox25
	default "DG150-WU7P2U" if TARGET_iopsys_brcm63xx_mips_dg150
	default "DG150V2-WU7P2U" if TARGET_iopsys_brcm63xx_mips_dg150v2

	help
		First part of image name

config TARGET_IBOARDID
	string
	prompt "Board ID" if TARGET_iopsys_brcm63xx_mips_Default

	default "CG300" if TARGET_iopsys_brcm63xx_mips_cg300
	default "CG301" if TARGET_iopsys_brcm63xx_mips_cg301
	default "DG200" if TARGET_iopsys_brcm63xx_mips_dg200
	default "DG200AL" if TARGET_iopsys_brcm63xx_mips_dg200al
	default "DG301AL" if TARGET_iopsys_brcm63xx_mips_dg301al
	default "EG200" if TARGET_iopsys_brcm63xx_mips_eg200
	default "EG300" if TARGET_iopsys_brcm63xx_mips_eg300
	default "D301" if TARGET_iopsys_brcm63xx_mips_dg301
	default "VG50" if TARGET_iopsys_brcm63xx_mips_vg50
	default "VOX25" if TARGET_iopsys_brcm63xx_mips_vox25
	default "D150" if TARGET_iopsys_brcm63xx_mips_dg150
	default "DG150V2" if TARGET_iopsys_brcm63xx_mips_dg150v2

	help
		4 letter id code used in the trailer or header to ensure the firmware to be flashed
		is for the correct board. This id is also used in the bcmkernel package to ensure
		that proper data tables are used when applicable. For example:
		D301 -> DG301
		VG50 -> VG50
		D201 -> DG201
```

## iopsys-brcm63xx-mips/image/Config.in
```kconfig
comment "Image naming"

config TARGET_VERSION
	string
	prompt "Model version"
	help
		Second part of image name
	
config TARGET_CUSTOMER
	string
	prompt "Customer ID"
	help
		A Customer id that is added to software file name

config TARGET_CFERAM_EXT
	string
	prompt "cferam.xxx file extension"
	default "001"
	help
		The extension to use for the root FS /cferam.xxx file, e.g. "001"

config TARGET_NO_1STBOOT_MARK
	bool "Don't add 'first boot' marker to root FS"
	default n
	help
		Don't add the empty file '/IOP3' to the root file system to indicate first boot.
		This is useful to prevent production test SW from mounting other partition.

config TARGET_NO_BLUETOOTH
	bool "Exclude Bluetooth"
	default n

config TARGET_NO_DECT
	bool "Exclude DECT"
	default n

config TARGET_NO_DHD
	bool "Exclude DHD"
	default n

config TARGET_NO_DSL
	bool "Exclude DSL"
	default n

config TARGET_NO_DSL_ANNEX_A
	bool "Exclude DSL Annex A"
	default n

config TARGET_NO_DSL_ANNEX_B
	bool "Exclude DSL Annex B"
	default n

config TARGET_NO_VOICE
	bool "Exclude Voice"
	default n

config TARGET_IMAGE_Y2
	bool "Generate a \".y2\" UBIFS CFE + root FS image"
	default y

config TARGET_IMAGE_CFE_Y2
	bool "Generate a \"_cfe.y2\" CFE only image"
	default n

config TARGET_IMAGE_FS_Y2
	bool "Generate a \"_fs.y2\" UBIFS root FS only image"
	default n

config TARGET_IMAGE_Y
	bool "Generate a legacy \".y\" UBIFS CFE + root FS image (deprecated)"
	default n

config TARGET_IMAGE_W
	bool "Generate a legacy \".w\" combined CFE + root FS image (deprecated)"
	default n

config TARGET_IMAGE_CFE
	bool "Generate a legacy \"_cfe\" CFE only image (deprecated)"
	default n

config TARGET_IMAGE_FS
	bool "Generate a legacy \"_fs_image\" JFFS2 root FS only image (deprecated)"
	default n
```

## iopsys-ramips/Config.in
```kconfig
# target config
config 	KERNEL_GIT_CLONE_URI
	string
	default "git@private.inteno.se:linux.git" if TARGET_iopsys_ramips_ex400

config 	KERNEL_GIT_BRANCH
	string
	default "mt7621_iopsys" if TARGET_iopsys_ramips_ex400

config	KERNEL_GIT_COMMIT
	string
	default "59bb1de05ad38eecc2ba923d046e22dbaa81776d" if TARGET_iopsys_ramips_ex400

config TARGET_IBOARDID
	string
	default "EX400" if TARGET_iopsys_ramips_ex400
	help
		4 letter id code used in the trailer or header to ensure the firmware to be flashed
		is for the correct board. This id is also used in the bcmkernel package to ensure
		that proper data tables are used when applicable. For example:
		D301 -> DG301
		VG50 -> VG50
		D201 -> DG201

config MEDIATEK_CHIP_ID
       string
       default "7621" if TARGET_iopsys_ramips_ex400

config TARGET_MODEL_NAME
	string
	prompt "Model name + configuration" if TARGET_iopsys_ramips_Default

	default "EX400-WU8U" if TARGET_iopsys_ramips_ex400
	help
		First part of image name

# hack to ensure that Device/Default is run
config TARGET_ROOTFS_INITRAMFS
       bool
       default y if TARGET_iopsys_ramips_ex400

# brctl from bridge-utils will be used instead
config 	BUSYBOX_DEFAULT_BRCTL
	bool
	default n if TARGET_iopsys_ramips

config TARGET_VERSION
	string
	prompt "Model version"
	help
		Second part of image name
	
config TARGET_CUSTOMER
	string
	prompt "Customer ID"
	help
		A Customer id that is added to software file name
```
